#include "16F1509_config.h"
#include <xc.h>
#include "lcd.h"
#include <string.h>
#define _XTAL_FREQ 1000000

#include <xc.h>

void main(void) {
    LCD_Initialize();
    LCDPutCmd(LCD_CURSOR_BLINK);
    LCDPutStr3("NGUYEN PHUC DUNG",0);
    
    LCDPutCmd(0x40);
    uint8_t cus[] = 
        {0x00,0x0A,0x1F,0x1F,0x1F,0x0E,0x04,0x00,
        0x00,0x0E,0x15,0x1B,0x0E,0x0E,0x00,0x00,
        0x01,0x03,0x05,0x09,0x0B,0x1B,0x18,0x00,
        0x00,0x1F,0x15,0x1F,0x1F,0x0E,0x0A,0x1B,
        0x0E,0x11,0x11,0x11,0x1F,0x1B,0x1B,0x1F};

    for (int i=0;i<40;i++){
        LCDPutChar(cus[i]); //added in CGRAM
    }
    
    LCDLine2();
    
    for (int m=0;m<5;m++){
        LCDPutChar(m);
        __delay_ms(80);
    }
    while(1);
    return;
}
